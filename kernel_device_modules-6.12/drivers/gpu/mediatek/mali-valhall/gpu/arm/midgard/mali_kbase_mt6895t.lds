SECTIONS {
	__patchable_function_entries : { *(__patchable_function_entries) }
	.text : {
		mtk_common_ged_dvfs_commit.cfi_jt = . + 0xa6630;
		mtk_common_ged_dvfs_dual_commit.cfi_jt = . + 0xa6638;
		mtk_common_cal_gpu_utilization_ex.cfi_jt = . + 0xa6640;
		MTKGPUFreq_change_notify.cfi_jt = . + 0xa6648;
		mtk_set_core_mask.cfi_jt = . + 0xa6650;
		mtk_common_get_system_timer.cfi_jt = . + 0xa6658;
		mtk_set_gpu_idle_time.cfi_jt = . + 0xa6660;
		MTK_LTR_gpu_pmu_start_swpm.cfi_jt = . + 0xa6668;
		MTK_LTR_gpu_pmu_start.cfi_jt = . + 0xa6670;
		mali_get_gpu_pmu_init.cfi_jt = . + 0xa6678;
		mali_get_gpu_pmu_swapnreset.cfi_jt = . + 0xa6680;
		_read_shader_u_rate.cfi_jt = . + 0xa6688;
		_read_alu_u_rate.cfi_jt = . + 0xa6690;
		_read_tex_u_rate.cfi_jt = . + 0xa6698;
		_read_lsc_u_rate.cfi_jt = . + 0xa66a0;
		_read_var_u_rate.cfi_jt = . + 0xa66a8;
		_read_shader_u_rate_w_loading.cfi_jt = . + 0xa66b0;
		_read_alu_u_rate_w_loading.cfi_jt = . + 0xa66b8;
		_read_tex_u_rate_w_loading.cfi_jt = . + 0xa66c0;
		_read_lsc_u_rate_w_loading.cfi_jt = . + 0xa66c8;
		_read_var_u_rate_w_loading.cfi_jt = . + 0xa66d0;
		kbase_sync_single_for_device.cfi_jt = . + 0xa66d8;
		kbase_sync_single_for_cpu.cfi_jt = . + 0xa66e0;
		kbasep_find_enclosing_gpu_mapping_start_and_offset.cfi_jt = . + 0xa66e8;
		kbasep_find_enclosing_cpu_mapping_offset.cfi_jt = . + 0xa66f0;
		kbase_sync_now.cfi_jt = . + 0xa66f8;
		kbase_mem_free_region.cfi_jt = . + 0xa6700;
		kbase_jit_free.cfi_jt = . + 0xa6708;
		kbase_jit_allocate.cfi_jt = . + 0xa6710;
		kbase_free_phy_pages_helper_locked.cfi_jt = . + 0xa6718;
		kbase_gpu_mmap.cfi_jt = . + 0xa6720;
		kbase_free_phy_pages_helper.cfi_jt = . + 0xa6728;
		kbase_alloc_phy_pages_helper.cfi_jt = . + 0xa6730;
		kbase_alloc_phy_pages.cfi_jt = . + 0xa6738;
		kbase_jit_debugfs_phys_get.cfi_jt = . + 0xa6740;
		kbase_jit_debugfs_vm_get.cfi_jt = . + 0xa6748;
		kbase_jit_debugfs_count_get.cfi_jt = . + 0xa6750;
		kbase_remove_va_region.cfi_jt = . + 0xa6758;
		kbase_region_tracker_init_jit.cfi_jt = . + 0xa6760;
		kbase_region_tracker_find_region_base_address.cfi_jt = . + 0xa6768;
		kbase_region_tracker_find_region_enclosing_address.cfi_jt = . + 0xa6770;
		kbase_reg_zone_get_name.cfi_jt = . + 0xa6778;
		kbase_free_alloced_region.cfi_jt = . + 0xa6780;
		kbase_ctx_reg_zone_get.cfi_jt = . + 0xa6788;
		kbase_ctx_alloc_free_region.cfi_jt = . + 0xa6790;
		kbase_bits_to_zone.cfi_jt = . + 0xa6798;
		kbase_alloc_free_region.cfi_jt = . + 0xa67a0;
		kbase_add_va_region.cfi_jt = . + 0xa67a8;
		kbase_mem_free.cfi_jt = . + 0xa67b0;
		kbase_region_tracker_init_exec.cfi_jt = . + 0xa67b8;
		kbase_reg_zone_same_va_init.cfi_jt = . + 0xa67c0;
		kbase_reg_zone_custom_va_init.cfi_jt = . + 0xa67c8;
		kbase_reg_zone_exec_va_init.cfi_jt = . + 0xa67d0;
		kbase_reg_zone_exec_fixed_va_init.cfi_jt = . + 0xa67d8;
		kbase_reg_zone_fixed_va_init.cfi_jt = . + 0xa67e0;
		kbase_is_large_pages_enabled.cfi_jt = . + 0xa67e8;
		kbase_is_page_migration_enabled.cfi_jt = . + 0xa67f0;
		kbase_page_migrate.cfi_jt = . + 0xa67f8;
		kbase_page_isolate.cfi_jt = . + 0xa6800;
		kbase_page_putback.cfi_jt = . + 0xa6808;
		kbase_native_mgm_alloc.cfi_jt = . + 0xa6810;
		kbase_native_mgm_free.cfi_jt = . + 0xa6818;
		kbase_native_mgm_update_gpu_pte.cfi_jt = . + 0xa6820;
		kbase_native_mgm_pte_to_original_pte.cfi_jt = . + 0xa6828;
		kbase_native_mgm_vmf_insert_pfn_prot.cfi_jt = . + 0xa6830;
		kbase_native_mgm_get_import_memory_cached_access_permitted.cfi_jt = . + 0xa6838;
		kbase_gpuprops_parse_gpu_id.cfi_jt = . + 0xa6840;
		trace_event_reg.cfi_jt = . + 0xa6848;
		trace_event_raw_init.cfi_jt = . + 0xa6850;
		__traceiter_perf_index_gpu.cfi_jt = . + 0xa6858;
		__traceiter_hwcnt_schedule_next_sample.cfi_jt = . + 0xa6860;
		__traceiter_hwcnt_client_dump.cfi_jt = . + 0xa6868;
		trace_event_raw_event_perf_index_gpu.cfi_jt = . + 0xa6870;
		perf_trace_perf_index_gpu.cfi_jt = . + 0xa6878;
		__bpf_trace_perf_index_gpu.cfi_jt = . + 0xa6880;
		trace_event_raw_event_hwcnt_skip_rearming.cfi_jt = . + 0xa6888;
		perf_trace_hwcnt_skip_rearming.cfi_jt = . + 0xa6890;
		__bpf_trace_hwcnt_skip_rearming.cfi_jt = . + 0xa6898;
		trace_event_raw_event_hwcnt_schedule_next_sample.cfi_jt = . + 0xa68a0;
		perf_trace_hwcnt_schedule_next_sample.cfi_jt = . + 0xa68a8;
		__bpf_trace_hwcnt_schedule_next_sample.cfi_jt = . + 0xa68b0;
		trace_event_raw_event_hwcnt_client_dump.cfi_jt = . + 0xa68b8;
		perf_trace_hwcnt_client_dump.cfi_jt = . + 0xa68c0;
		__bpf_trace_hwcnt_client_dump.cfi_jt = . + 0xa68c8;
		kbase_gator_instr_hwcnt_dump_irq.cfi_jt = . + 0xa68d0;
		kbase_gator_instr_hwcnt_dump_complete.cfi_jt = . + 0xa68d8;
		kbase_gator_hwcnt_term.cfi_jt = . + 0xa68e0;
		kbase_gator_hwcnt_init_names.cfi_jt = . + 0xa68e8;
		kbase_gator_hwcnt_init.cfi_jt = . + 0xa68f0;
		kbase_vunmap.cfi_jt = . + 0xa68f8;
		kbase_vmap.cfi_jt = . + 0xa6900;
		kbase_mem_alloc.cfi_jt = . + 0xa6908;
		kbase_context_mmap.cfi_jt = . + 0xa6910;
		kbase_csf_user_io_pages_vm_split.cfi_jt = . + 0xa6918;
		kbase_cpu_vm_open.cfi_jt = . + 0xa6920;
		kbase_cpu_vm_close.cfi_jt = . + 0xa6928;
		kbase_csf_user_io_pages_vm_open.cfi_jt = . + 0xa6930;
		kbase_csf_user_io_pages_vm_close.cfi_jt = . + 0xa6938;
		kbase_csf_user_reg_vm_open.cfi_jt = . + 0xa6940;
		kbase_csf_user_reg_vm_close.cfi_jt = . + 0xa6948;
		kbase_csf_user_io_pages_vm_mremap.cfi_jt = . + 0xa6950;
		kbase_csf_user_reg_vm_mremap.cfi_jt = . + 0xa6958;
		kbase_cpu_vm_fault.cfi_jt = . + 0xa6960;
		kbase_csf_user_io_pages_vm_fault.cfi_jt = . + 0xa6968;
		kbase_csf_user_reg_vm_fault.cfi_jt = . + 0xa6970;
		__traceiter_sysgraph_gpu.cfi_jt = . + 0xa6978;
		__traceiter_sysgraph.cfi_jt = . + 0xa6980;
		__traceiter_mali_mmu_page_fault_grow.cfi_jt = . + 0xa6988;
		__traceiter_mali_mmu_page_fault_extra_grow.cfi_jt = . + 0xa6990;
		__traceiter_mali_jit_trim_from_region.cfi_jt = . + 0xa6998;
		__traceiter_mali_jit_trim.cfi_jt = . + 0xa69a0;
		__traceiter_mali_jit_report_gpu_mem.cfi_jt = . + 0xa69a8;
		__traceiter_mali_jit_free.cfi_jt = . + 0xa69b0;
		__traceiter_mali_jit_alloc.cfi_jt = . + 0xa69b8;
		__traceiter_mali_gpu_active_cycle_counter.cfi_jt = . + 0xa69c0;
		trace_event_raw_event_sysgraph_gpu.cfi_jt = . + 0xa69c8;
		perf_trace_sysgraph_gpu.cfi_jt = . + 0xa69d0;
		__bpf_trace_sysgraph_gpu.cfi_jt = . + 0xa69d8;
		trace_event_raw_event_sysgraph.cfi_jt = . + 0xa69e0;
		perf_trace_sysgraph.cfi_jt = . + 0xa69e8;
		__bpf_trace_sysgraph.cfi_jt = . + 0xa69f0;
		trace_event_raw_event_mali_mmu_page_fault_grow.cfi_jt = . + 0xa69f8;
		perf_trace_mali_mmu_page_fault_grow.cfi_jt = . + 0xa6a00;
		trace_event_raw_event_mali_mmu_page_fault_extra_grow.cfi_jt = . + 0xa6a08;
		perf_trace_mali_mmu_page_fault_extra_grow.cfi_jt = . + 0xa6a10;
		__bpf_trace_mali_mmu_page_fault_grow.cfi_jt = . + 0xa6a18;
		__bpf_trace_mali_mmu_page_fault_extra_grow.cfi_jt = . + 0xa6a20;
		trace_event_raw_event_mali_jit_trim_from_region.cfi_jt = . + 0xa6a28;
		perf_trace_mali_jit_trim_from_region.cfi_jt = . + 0xa6a30;
		__bpf_trace_mali_jit_trim_from_region.cfi_jt = . + 0xa6a38;
		trace_event_raw_event_mali_jit_trim.cfi_jt = . + 0xa6a40;
		perf_trace_mali_jit_trim.cfi_jt = . + 0xa6a48;
		__bpf_trace_mali_jit_trim.cfi_jt = . + 0xa6a50;
		trace_event_raw_event_mali_jit_report_gpu_mem.cfi_jt = . + 0xa6a58;
		perf_trace_mali_jit_report_gpu_mem.cfi_jt = . + 0xa6a60;
		__bpf_trace_mali_jit_report_gpu_mem.cfi_jt = . + 0xa6a68;
		trace_event_raw_event_mali_jit_softjob_template.cfi_jt = . + 0xa6a70;
		perf_trace_mali_jit_softjob_template.cfi_jt = . + 0xa6a78;
		__bpf_trace_mali_jit_softjob_template.cfi_jt = . + 0xa6a80;
		trace_event_raw_event_mali_gpu_active_cycle_counter.cfi_jt = . + 0xa6a88;
		perf_trace_mali_gpu_active_cycle_counter.cfi_jt = . + 0xa6a90;
		__bpf_trace_mali_gpu_active_cycle_counter.cfi_jt = . + 0xa6a98;
		kbase_find_device.cfi_jt = . + 0xa6aa0;
		kbasep_protected_mode_enable.cfi_jt = . + 0xa6aa8;
		kbasep_protected_mode_disable.cfi_jt = . + 0xa6ab0;
		seq_lseek.cfi_jt = . + 0xa6ab8;
		generic_file_llseek.cfi_jt = . + 0xa6ac0;
		no_llseek.cfi_jt = . + 0xa6ac8;
		default_llseek.cfi_jt = . + 0xa6ad0;
		kbasep_kinstr_prfcnt_hwcnt_reader_ioctl.cfi_jt = . + 0xa6ad8;
		kbase_ioctl.cfi_jt = . + 0xa6ae0;
		kbasep_kinstr_prfcnt_hwcnt_reader_mmap.cfi_jt = . + 0xa6ae8;
		kbase_mmap.cfi_jt = . + 0xa6af0;
		kbase_get_unmapped_area.cfi_jt = . + 0xa6af8;
		kbase_check_flags.cfi_jt = . + 0xa6b00;
		mali_get_gpu_pmu_deinit.cfi_jt = . + 0xa6b08;
		mali_get_gpu_pmu_swapnreset_stop.cfi_jt = . + 0xa6b10;
		init_module.cfi_jt = . + 0xa6b18;
		kbase_platform_device_probe.cfi_jt = . + 0xa6b20;
		kbase_platform_device_remove.cfi_jt = . + 0xa6b28;
		kbase_device_suspend.cfi_jt = . + 0xa6b30;
		kbase_device_resume.cfi_jt = . + 0xa6b38;
		kbase_device_runtime_suspend.cfi_jt = . + 0xa6b40;
		kbase_device_runtime_resume.cfi_jt = . + 0xa6b48;
		kbase_device_runtime_idle.cfi_jt = . + 0xa6b50;
		MTK_GPU_Power_model_sspm_enable.cfi_jt = . + 0xa6b58;
		MTK_LTR_gpu_pmu_suspend.cfi_jt = . + 0xa6b60;
		MTK_LTR_gpu_pmu_stop.cfi_jt = . + 0xa6b68;
		MTK_LTR_gpu_pmu_resume.cfi_jt = . + 0xa6b70;
		kbasep_debug_assert_call_hook.cfi_jt = . + 0xa6b78;
		kbase_gator_hwcnt_term_names.cfi_jt = . + 0xa6b80;
		cleanup_module.cfi_jt = . + 0xa6b88;
		kbase_disjoint_event_get.cfi_jt = . + 0xa6b90;
		kbase_mem_pool_free_page.cfi_jt = . + 0xa6b98;
		kbase_mem_pool_grow.cfi_jt = . + 0xa6ba0;
		kbase_mem_pool_trim.cfi_jt = . + 0xa6ba8;
		kbase_mem_pool_set_max_size.cfi_jt = . + 0xa6bb0;
		kbase_mem_pool_term.cfi_jt = . + 0xa6bb8;
		kbase_mem_pool_mark_dying.cfi_jt = . + 0xa6bc0;
		kbase_mem_pool_init_no_reclaim.cfi_jt = . + 0xa6bc8;
		kbase_mem_pool_init.cfi_jt = . + 0xa6bd0;
		kbase_mem_pool_free_pages_from_deferred_list.cfi_jt = . + 0xa6bd8;
		kbase_mem_pool_free_pages_locked.cfi_jt = . + 0xa6be0;
		kbase_mem_pool_free_pages.cfi_jt = . + 0xa6be8;
		kbase_mem_pool_free_locked.cfi_jt = . + 0xa6bf0;
		kbase_mem_pool_free.cfi_jt = . + 0xa6bf8;
		kbase_mem_pool_deferred_list_size.cfi_jt = . + 0xa6c00;
		kbase_mem_pool_alloc_pages_locked.cfi_jt = . + 0xa6c08;
		kbase_mem_pool_alloc_pages.cfi_jt = . + 0xa6c10;
		kbase_mem_alloc_page.cfi_jt = . + 0xa6c18;
		kbase_mem_pool_alloc.cfi_jt = . + 0xa6c20;
		kbase_mem_pool_debugfs_trim.cfi_jt = . + 0xa6c28;
		kbase_mem_pool_debugfs_set_max_size.cfi_jt = . + 0xa6c30;
		kbase_mem_pool_debugfs_size.cfi_jt = . + 0xa6c38;
		kbase_mem_pool_debugfs_max_size.cfi_jt = . + 0xa6c40;
		trace_raw_output_perf_index_gpu.cfi_jt = . + 0xa6c48;
		trace_raw_output_hwcnt_skip_rearming.cfi_jt = . + 0xa6c50;
		trace_raw_output_hwcnt_schedule_next_sample.cfi_jt = . + 0xa6c58;
		trace_raw_output_hwcnt_client_dump.cfi_jt = . + 0xa6c60;
		trace_raw_output_sysgraph_gpu.cfi_jt = . + 0xa6c68;
		trace_raw_output_sysgraph.cfi_jt = . + 0xa6c70;
		trace_raw_output_mali_mmu_page_fault_grow.cfi_jt = . + 0xa6c78;
		trace_raw_output_mali_mmu_page_fault_extra_grow.cfi_jt = . + 0xa6c80;
		trace_raw_output_mali_jit_trim_from_region.cfi_jt = . + 0xa6c88;
		trace_raw_output_mali_jit_trim.cfi_jt = . + 0xa6c90;
		trace_raw_output_mali_jit_report_gpu_mem.cfi_jt = . + 0xa6c98;
		trace_raw_output_mali_jit_free.cfi_jt = . + 0xa6ca0;
		trace_raw_output_mali_jit_softjob_template.cfi_jt = . + 0xa6ca8;
		trace_raw_output_mali_gpu_active_cycle_counter.cfi_jt = . + 0xa6cb0;
		trace_raw_output_gpu.cfi_jt = . + 0xa6cb8;
		__traceiter_gpu_frequency.cfi_jt = . + 0xa6cc0;
		trace_event_raw_event_gpu.cfi_jt = . + 0xa6cc8;
		perf_trace_gpu.cfi_jt = . + 0xa6cd0;
		__bpf_trace_gpu.cfi_jt = . + 0xa6cd8;
		kbase_io_test_status.cfi_jt = . + 0xa6ce0;
		kbase_io_history_init.cfi_jt = . + 0xa6ce8;
		kbase_io_set_status.cfi_jt = . + 0xa6cf0;
		kbase_io_clear_status.cfi_jt = . + 0xa6cf8;
		kbase_fence_get_driver_name.cfi_jt = . + 0xa6d00;
		kbase_fence_get_timeline_name.cfi_jt = . + 0xa6d08;
		kbase_fence_enable_signaling.cfi_jt = . + 0xa6d10;
		dma_fence_default_wait.cfi_jt = . + 0xa6d18;
		kbase_fence_release.cfi_jt = . + 0xa6d20;
		kbase_fence_fence_value_str.cfi_jt = . + 0xa6d28;
		kbase_mem_kref_free.cfi_jt = . + 0xa6d30;
		dma_fence_release.cfi_jt = . + 0xa6d38;
		kbase_arbiter_pm_vm_event.cfi_jt = . + 0xa6d40;
		get_arb_gpu_clk.cfi_jt = . + 0xa6d48;
		get_arb_gpu_clk_rate.cfi_jt = . + 0xa6d50;
		arb_gpu_clk_notifier_register.cfi_jt = . + 0xa6d58;
		arb_gpu_clk_notifier_unregister.cfi_jt = . + 0xa6d60;
		kbase_has_exec_va_zone.cfi_jt = . + 0xa6d68;
		kbase_ctx_compat_mode.cfi_jt = . + 0xa6d70;
		kbase_create_context.cfi_jt = . + 0xa6d78;
		kbase_device_put_list.cfi_jt = . + 0xa6d80;
		kbase_device_get_list.cfi_jt = . + 0xa6d88;
		kbase_gpu_interrupt.cfi_jt = . + 0xa6d90;
		kbase_combined_irq_handler.cfi_jt = . + 0xa6d98;
		kbase_job_irq_handler.cfi_jt = . + 0xa6da0;
		kbase_mmu_irq_handler.cfi_jt = . + 0xa6da8;
		kbase_gpu_irq_handler.cfi_jt = . + 0xa6db0;
		kbase_pm_get_domain_status.cfi_jt = . + 0xa6db8;
		kbase_pm_get_trans_cores.cfi_jt = . + 0xa6dc0;
		kbase_pm_get_ready_cores.cfi_jt = . + 0xa6dc8;
		kbase_pm_get_present_cores.cfi_jt = . + 0xa6dd0;
		kbase_pm_get_active_cores.cfi_jt = . + 0xa6dd8;
		kbase_pm_clock_on.cfi_jt = . + 0xa6de0;
		kbase_pm_get_dvfs_metrics.cfi_jt = . + 0xa6de8;
		kbase_pm_ca_get_core_masks.cfi_jt = . + 0xa6df0;
		kbase_pm_set_debug_core_mask.cfi_jt = . + 0xa6df8;
		kbase_devfreq_set_core_mask.cfi_jt = . + 0xa6e00;
		kbase_pm_set_policy.cfi_jt = . + 0xa6e08;
		kbase_pm_list_policies.cfi_jt = . + 0xa6e10;
		kbase_pm_get_policy.cfi_jt = . + 0xa6e18;
		kbase_get_timeout_ms.cfi_jt = . + 0xa6e20;
		kbase_backend_time_convert_gpu_to_cpu.cfi_jt = . + 0xa6e28;
		kbase_backend_get_gpu_time_norequest.cfi_jt = . + 0xa6e30;
		kbase_backend_get_gpu_time.cfi_jt = . + 0xa6e38;
		kbase_clk_rate_trace_manager_notify_all.cfi_jt = . + 0xa6e40;
		pcm_prioritized_process_cb.cfi_jt = . + 0xa6e48;
		mali_oom_notifier_handler.cfi_jt = . + 0xa6e50;
		gpu_clk_rate_change_notifier.cfi_jt = . + 0xa6e58;
		kbase_devfreq_target.cfi_jt = . + 0xa6e60;
		kbase_devfreq_status.cfi_jt = . + 0xa6e68;
		kbase_devfreq_cur_freq.cfi_jt = . + 0xa6e70;
		kbase_devfreq_exit.cfi_jt = . + 0xa6e78;
		mmu_get_lowest_valid_pgd.cfi_jt = . + 0xa6e80;
		kbase_mmu_insert_pages.cfi_jt = . + 0xa6e88;
		kbase_mmu_insert_aliased_pages.cfi_jt = . + 0xa6e90;
		kbase_mmu_teardown_pages.cfi_jt = . + 0xa6e98;
		kbase_mmu_update.cfi_jt = . + 0xa6ea0;
		mmu_update.cfi_jt = . + 0xa6ea8;
		pte_to_phy_addr.cfi_jt = . + 0xa6eb0;
		ate_is_valid.cfi_jt = . + 0xa6eb8;
		pte_is_valid.cfi_jt = . + 0xa6ec0;
		entry_set_ate.cfi_jt = . + 0xa6ec8;
		entry_set_pte.cfi_jt = . + 0xa6ed0;
		get_num_valid_entries.cfi_jt = . + 0xa6ed8;
		entries_invalidate.cfi_jt = . + 0xa6ee0;
		set_num_valid_entries.cfi_jt = . + 0xa6ee8;
		kbase_mmu_report_mcu_as_fault_and_reset.cfi_jt = . + 0xa6ef0;
		kbase_mmu_gpu_fault_interrupt.cfi_jt = . + 0xa6ef8;
		kbase_mmu_get_as_setup.cfi_jt = . + 0xa6f00;
		kbasep_kinstr_prfcnt_hwcnt_reader_poll.cfi_jt = . + 0xa6f08;
		kbase_poll.cfi_jt = . + 0xa6f10;
		kbasep_timeline_io_poll.cfi_jt = . + 0xa6f18;
		kbasep_timeline_io_fsync.cfi_jt = . + 0xa6f20;
		kbasep_hwcnt_watchdog_if_timer_enable.cfi_jt = . + 0xa6f28;
		kbasep_hwcnt_watchdog_if_timer_disable.cfi_jt = . + 0xa6f30;
		kbasep_hwcnt_watchdog_if_timer_modify.cfi_jt = . + 0xa6f38;
		kbase_ktrace_hook_wrapper.cfi_jt = . + 0xa6f40;
		kbasep_hwcnt_backend_watchdog_timer_cb.cfi_jt = . + 0xa6f48;
		kbasep_hwcnt_backend_csf_metadata.cfi_jt = . + 0xa6f50;
		kbasep_hwcnt_backend_csf_init.cfi_jt = . + 0xa6f58;
		kbasep_hwcnt_backend_csf_term.cfi_jt = . + 0xa6f60;
		kbasep_hwcnt_backend_csf_acquire.cfi_jt = . + 0xa6f68;
		kbasep_hwcnt_backend_csf_release.cfi_jt = . + 0xa6f70;
		kbasep_hwcnt_backend_csf_timestamp_ns.cfi_jt = . + 0xa6f78;
		kbasep_hwcnt_backend_csf_dump_enable_nolock.cfi_jt = . + 0xa6f80;
		kbasep_hwcnt_backend_csf_dump_enable.cfi_jt = . + 0xa6f88;
		kbasep_hwcnt_backend_csf_dump_disable.cfi_jt = . + 0xa6f90;
		kbasep_hwcnt_backend_csf_dump_clear.cfi_jt = . + 0xa6f98;
		kbasep_hwcnt_backend_csf_dump_request.cfi_jt = . + 0xa6fa0;
		kbasep_hwcnt_backend_csf_dump_wait.cfi_jt = . + 0xa6fa8;
		kbasep_hwcnt_backend_csf_dump_get.cfi_jt = . + 0xa6fb0;
		kbasep_hwcnt_backend_csf_if_fw_lock.cfi_jt = . + 0xa6fb8;
		kbasep_hwcnt_backend_csf_if_fw_unlock.cfi_jt = . + 0xa6fc0;
		kbasep_hwcnt_backend_csf_if_fw_get_prfcnt_info.cfi_jt = . + 0xa6fc8;
		kbasep_hwcnt_backend_csf_if_fw_ring_buf_alloc.cfi_jt = . + 0xa6fd0;
		kbasep_hwcnt_backend_csf_if_fw_ring_buf_sync.cfi_jt = . + 0xa6fd8;
		kbasep_hwcnt_backend_csf_if_fw_ring_buf_free.cfi_jt = . + 0xa6fe0;
		kbasep_hwcnt_backend_csf_if_fw_timestamp_ns.cfi_jt = . + 0xa6fe8;
		kbasep_hwcnt_backend_csf_if_fw_dump_enable.cfi_jt = . + 0xa6ff0;
		kbasep_hwcnt_backend_csf_if_fw_assert_lock_held.cfi_jt = . + 0xa6ff8;
		kbasep_hwcnt_backend_csf_if_fw_acquire.cfi_jt = . + 0xa7000;
		kbasep_hwcnt_backend_csf_if_fw_release.cfi_jt = . + 0xa7008;
		kbasep_hwcnt_backend_csf_if_fw_dump_disable.cfi_jt = . + 0xa7010;
		kbasep_hwcnt_backend_csf_if_fw_dump_request.cfi_jt = . + 0xa7018;
		kbasep_hwcnt_backend_csf_if_fw_get_gpu_cycle_count.cfi_jt = . + 0xa7020;
		kbasep_hwcnt_backend_csf_if_fw_get_indexes.cfi_jt = . + 0xa7028;
		kbasep_hwcnt_backend_csf_if_fw_set_extract_index.cfi_jt = . + 0xa7030;
		kbasep_hwcnt_backend_csf_if_fw_time_convert_gpu_to_cpu.cfi_jt = . + 0xa7038;
		kbase_reg_write64.cfi_jt = . + 0xa7040;
		kbase_reg_write32.cfi_jt = . + 0xa7048;
		kbase_reg_read64_coherent.cfi_jt = . + 0xa7050;
		kbase_reg_read64.cfi_jt = . + 0xa7058;
		kbase_reg_read32.cfi_jt = . + 0xa7060;
		fw_cfg_kobj_release.cfi_jt = . + 0xa7068;
		show_fw_cfg.cfi_jt = . + 0xa7070;
		store_fw_cfg.cfi_jt = . + 0xa7078;
		set_large_page_conf.cfi_jt = . + 0xa7080;
		set_mma_wa_id.cfi_jt = . + 0xa7088;
		kbase_unprivileged_global_profiling_set.cfi_jt = . + 0xa7090;
		set_csf_fw_log_buf_size.cfi_jt = . + 0xa7098;
		get_large_page_conf.cfi_jt = . + 0xa70a0;
		param_get_uint.cfi_jt = . + 0xa70a8;
		param_get_int.cfi_jt = . + 0xa70b0;
		get_csf_fw_log_buf_size.cfi_jt = . + 0xa70b8;
		kbase_csf_firmware_trace_buffer_update_trace_enable_bit.cfi_jt = . + 0xa70c0;
		kbase_csf_firmware_trace_buffer_read_data.cfi_jt = . + 0xa70c8;
		kbase_csf_firmware_trace_buffer_is_empty.cfi_jt = . + 0xa70d0;
		kbase_csf_firmware_trace_buffer_get_trace_enable_bits_count.cfi_jt = . + 0xa70d8;
		kbase_csf_firmware_trace_buffer_discard.cfi_jt = . + 0xa70e0;
		kbase_csf_firmware_get_trace_buffer.cfi_jt = . + 0xa70e8;
		kbase_csf_queue_group_terminate.cfi_jt = . + 0xa70f0;
		kbase_csf_handle_pending_oom_interrupt.cfi_jt = . + 0xa70f8;
		kbase_csf_cs_get_pending_oom.cfi_jt = . + 0xa7100;
		kbase_csf_free_oom_tiler_heap_chunk.cfi_jt = . + 0xa7108;
		kbase_csf_free_command_stream_user_pages.cfi_jt = . + 0xa7110;
		kbase_csf_find_queue_group.cfi_jt = . + 0xa7118;
		kbase_csf_alloc_command_stream_user_pages.cfi_jt = . + 0xa7120;
		kbase_jit_init.cfi_jt = . + 0xa7128;
		kbase_sticky_resource_init.cfi_jt = . + 0xa7130;
		kbase_region_tracker_init.cfi_jt = . + 0xa7138;
		kbase_ctx_sched_init_ctx.cfi_jt = . + 0xa7140;
		kbase_mem_evictable_init.cfi_jt = . + 0xa7148;
		kbase_event_pending.cfi_jt = . + 0xa7150;
		kbase_context_common_init.cfi_jt = . + 0xa7158;
		kbase_context_add_to_dev_list.cfi_jt = . + 0xa7160;
		kbase_context_mem_pool_group_init.cfi_jt = . + 0xa7168;
		kbase_context_pgd_mem_pool_init.cfi_jt = . + 0xa7170;
		kbase_context_mmu_init.cfi_jt = . + 0xa7178;
		kbase_context_mem_alloc_page.cfi_jt = . + 0xa7180;
		kbase_csf_ctx_init.cfi_jt = . + 0xa7188;
		csg_slot_stopped_locked.cfi_jt = . + 0xa7190;
		csg_slot_running.cfi_jt = . + 0xa7198;
		csg_slot_stopped_raw.cfi_jt = . + 0xa71a0;
		kbase_csf_scheduler_group_copy_suspend_buf.cfi_jt = . + 0xa71a8;
		kbasep_kinstr_prfcnt_dump_timer.cfi_jt = . + 0xa71b0;
		shader_tick_timer_callback.cfi_jt = . + 0xa71b8;
		kbasep_reset_timeout.cfi_jt = . + 0xa71c0;
		dvfs_callback.cfi_jt = . + 0xa71c8;
		tick_timer_callback.cfi_jt = . + 0xa71d0;
		kbase_csf_kcpu_queue_metadata_new.cfi_jt = . + 0xa71d8;
		kbase_kcpu_fence_signal_process.cfi_jt = . + 0xa71e0;
		kbase_kcpu_fence_signal_init.cfi_jt = . + 0xa71e8;
		kbase_csf_kcpu_queue_new.cfi_jt = . + 0xa71f0;
		kbase_csf_scheduler_check_group_sync_update_cb.cfi_jt = . + 0xa71f8;
		event_cqs_callback.cfi_jt = . + 0xa7200;
		kbase_csf_fence_wait_callback.cfi_jt = . + 0xa7208;
		kbase_gpu_vm_unlock.cfi_jt = . + 0xa7210;
		kbase_gpu_vm_lock.cfi_jt = . + 0xa7218;
		kbase_jit_term.cfi_jt = . + 0xa7220;
		kbase_reg_zone_same_va_term.cfi_jt = . + 0xa7228;
		kbase_reg_zone_custom_va_term.cfi_jt = . + 0xa7230;
		kbase_reg_zone_exec_va_term.cfi_jt = . + 0xa7238;
		kbase_reg_zone_exec_fixed_va_term.cfi_jt = . + 0xa7240;
		kbase_reg_zone_fixed_va_term.cfi_jt = . + 0xa7248;
		kbase_region_tracker_term.cfi_jt = . + 0xa7250;
		kbase_mem_evictable_deinit.cfi_jt = . + 0xa7258;
		kbase_event_wakeup.cfi_jt = . + 0xa7260;
		kbase_context_remove_from_dev_list.cfi_jt = . + 0xa7268;
		kbase_context_common_term.cfi_jt = . + 0xa7270;
		kbase_context_mem_pool_group_term.cfi_jt = . + 0xa7278;
		kbase_context_pgd_mem_pool_term.cfi_jt = . + 0xa7280;
		kbase_context_mmu_term.cfi_jt = . + 0xa7288;
		kbase_context_mem_pool_free.cfi_jt = . + 0xa7290;
		kbase_context_sticky_resource_term.cfi_jt = . + 0xa7298;
		kbase_destroy_context.cfi_jt = . + 0xa72a0;
		kbase_context_free.cfi_jt = . + 0xa72a8;
		kbase_context_debugfs_term.cfi_jt = . + 0xa72b0;
		kbase_context_debugfs_init.cfi_jt = . + 0xa72b8;
		kbase_mmu_disable.cfi_jt = . + 0xa72c0;
		kbase_csf_ctx_term.cfi_jt = . + 0xa72c8;
		kbase_csf_kcpu_queue_context_term.cfi_jt = . + 0xa72d0;
		core_mask_show.cfi_jt = . + 0xa72d8;
		power_policy_show.cfi_jt = . + 0xa72e0;
		mcu_shader_pwroff_timeout_ns_show.cfi_jt = . + 0xa72e8;
		mcu_shader_pwroff_timeout_show.cfi_jt = . + 0xa72f0;
		idle_hysteresis_time_ns_show.cfi_jt = . + 0xa72f8;
		idle_hysteresis_time_show.cfi_jt = . + 0xa7300;
		fw_timeout_show.cfi_jt = . + 0xa7308;
		csg_scheduling_period_show.cfi_jt = . + 0xa7310;
		reset_timeout_show.cfi_jt = . + 0xa7318;
		pm_poweroff_show.cfi_jt = . + 0xa7320;
		dvfs_period_show.cfi_jt = . + 0xa7328;
		gpuinfo_show.cfi_jt = . + 0xa7330;
		progress_timeout_show.cfi_jt = . + 0xa7338;
		core_mask_store.cfi_jt = . + 0xa7340;
		power_policy_store.cfi_jt = . + 0xa7348;
		mcu_shader_pwroff_timeout_ns_store.cfi_jt = . + 0xa7350;
		mcu_shader_pwroff_timeout_store.cfi_jt = . + 0xa7358;
		idle_hysteresis_time_ns_store.cfi_jt = . + 0xa7360;
		idle_hysteresis_time_store.cfi_jt = . + 0xa7368;
		fw_timeout_store.cfi_jt = . + 0xa7370;
		remove_prioritized_process_store.cfi_jt = . + 0xa7378;
		add_prioritized_process_store.cfi_jt = . + 0xa7380;
		csg_scheduling_period_store.cfi_jt = . + 0xa7388;
		reset_timeout_store.cfi_jt = . + 0xa7390;
		pm_poweroff_store.cfi_jt = . + 0xa7398;
		dvfs_period_store.cfi_jt = . + 0xa73a0;
		progress_timeout_store.cfi_jt = . + 0xa73a8;
		kbasep_timeline_autoflush_timer_callback.cfi_jt = . + 0xa73b0;
		delayed_work_timer_fn.cfi_jt = . + 0xa73b8;
		fence_signal_timeout_cb.cfi_jt = . + 0xa73c0;
		kbasep_csf_tl_reader_read_callback.cfi_jt = . + 0xa73c8;
		kbase_prepare_to_reset_gpu.cfi_jt = . + 0xa73d0;
		debug_mem_start.cfi_jt = . + 0xa73d8;
		fw_core_dump_seq_start.cfi_jt = . + 0xa73e0;
		debug_mem_stop.cfi_jt = . + 0xa73e8;
		fw_core_dump_seq_stop.cfi_jt = . + 0xa73f0;
		debug_mem_next.cfi_jt = . + 0xa73f8;
		fw_core_dump_seq_next.cfi_jt = . + 0xa7400;
		mtk_dvfs_gpu_utilization_show.cfi_jt = . + 0xa7408;
		kbasep_gpu_memory_seq_show.cfi_jt = . + 0xa7410;
		kbase_device_debugfs_heap_reclaim_offslot_show.cfi_jt = . + 0xa7418;
		kbasep_mem_profile_seq_show.cfi_jt = . + 0xa7420;
		debug_mem_show.cfi_jt = . + 0xa7428;
		debug_mem_zones_show.cfi_jt = . + 0xa7430;
		debug_ctx_mem_allocs_show.cfi_jt = . + 0xa7438;
		kbase_mem_pool_debugfs_max_size_show.cfi_jt = . + 0xa7440;
		kbase_mem_pool_debugfs_size_show.cfi_jt = . + 0xa7448;
		kbase_dev_mem_pool_debugfs_max_size_show.cfi_jt = . + 0xa7450;
		kbase_dev_mem_pool_debugfs_size_show.cfi_jt = . + 0xa7458;
		kbasep_dvfs_utilization_debugfs_show.cfi_jt = . + 0xa7460;
		regs_history_show.cfi_jt = . + 0xa7468;
		propagate_bits_show.cfi_jt = . + 0xa7470;
		int_id_overrides_show.cfi_jt = . + 0xa7478;
		kbasep_csf_queue_show_groups.cfi_jt = . + 0xa7480;
		kbasep_csf_csg_active_show_groups.cfi_jt = . + 0xa7488;
		kbasep_csf_kcpu_debugfs_show.cfi_jt = . + 0xa7490;
		kbasep_csf_sync_debugfs_show.cfi_jt = . + 0xa7498;
		kbasep_csf_tiler_heap_debugfs_show.cfi_jt = . + 0xa74a0;
		kbasep_csf_tiler_heap_total_debugfs_show.cfi_jt = . + 0xa74a8;
		kbasep_csf_cpu_queue_debugfs_show.cfi_jt = . + 0xa74b0;
		fw_core_dump_seq_show.cfi_jt = . + 0xa74b8;
		kbase_mem_evictable_reclaim_count_objects.cfi_jt = . + 0xa74c0;
		kbase_mem_evictable_reclaim_scan_objects.cfi_jt = . + 0xa74c8;
		kbase_mem_pool_reclaim_count_objects.cfi_jt = . + 0xa74d0;
		kbase_mem_pool_reclaim_scan_objects.cfi_jt = . + 0xa74d8;
		kbase_csf_tiler_heap_reclaim_count_objects.cfi_jt = . + 0xa74e0;
		kbase_csf_tiler_heap_reclaim_scan_objects.cfi_jt = . + 0xa74e8;
		mmu_disable_as.cfi_jt = . + 0xa74f0;
		kbase_csf_ring_doorbell.cfi_jt = . + 0xa74f8;
		kbase_csf_firmware_set_gpu_idle_hysteresis_time.cfi_jt = . + 0xa7500;
		kbase_io_is_gpu_powered.cfi_jt = . + 0xa7508;
		kbase_io_is_aw_removed.cfi_jt = . + 0xa7510;
		kbase_io_has_gpu.cfi_jt = . + 0xa7518;
		kbase_pm_clock_off.cfi_jt = . + 0xa7520;
		kbase_pm_metrics_is_active.cfi_jt = . + 0xa7528;
		always_on_shaders_needed.cfi_jt = . + 0xa7530;
		always_on_get_core_active.cfi_jt = . + 0xa7538;
		coarse_demand_shaders_needed.cfi_jt = . + 0xa7540;
		coarse_demand_get_core_active.cfi_jt = . + 0xa7548;
		kbase_csf_firmware_is_mcu_in_sleep.cfi_jt = . + 0xa7550;
		kbase_csf_firmware_get_mcu_core_pwroff_time.cfi_jt = . + 0xa7558;
		kbase_csf_fw_io_stream_write_mask.cfi_jt = . + 0xa7560;
		kbase_csf_fw_io_stream_read.cfi_jt = . + 0xa7568;
		kbase_csf_fw_io_stream_input_read.cfi_jt = . + 0xa7570;
		kbase_csf_fw_io_init.cfi_jt = . + 0xa7578;
		kbase_csf_fw_io_stream_write.cfi_jt = . + 0xa7580;
		kbase_csf_fw_io_group_write_mask.cfi_jt = . + 0xa7588;
		kbase_csf_fw_io_group_write64_mask.cfi_jt = . + 0xa7590;
		kbase_csf_fw_io_group_write64.cfi_jt = . + 0xa7598;
		kbase_csf_fw_io_group_read.cfi_jt = . + 0xa75a0;
		kbase_csf_fw_io_group_input_read.cfi_jt = . + 0xa75a8;
		kbase_csf_fw_io_group_input64_read.cfi_jt = . + 0xa75b0;
		kbase_csf_fw_io_group_write.cfi_jt = . + 0xa75b8;
		kbase_csf_fw_io_global_write_mask.cfi_jt = . + 0xa75c0;
		kbase_csf_fw_io_global_write.cfi_jt = . + 0xa75c8;
		kbase_csf_fw_io_global_read.cfi_jt = . + 0xa75d0;
		kbase_csf_fw_io_global_input_read.cfi_jt = . + 0xa75d8;
		kbase_csf_fw_io_term.cfi_jt = . + 0xa75e0;
		kbase_csf_fw_io_set_status_gpu_suspended.cfi_jt = . + 0xa75e8;
		kbase_csf_fw_io_clear_status_gpu_suspended.cfi_jt = . + 0xa75f0;
		kbase_csf_fw_io_check_status_gpu_suspended.cfi_jt = . + 0xa75f8;
		kbase_ipa_control_unregister.cfi_jt = . + 0xa7600;
		kbase_ipa_control_register.cfi_jt = . + 0xa7608;
		kbase_ipa_control_query.cfi_jt = . + 0xa7610;
		kbase_jit_destroy_worker.cfi_jt = . + 0xa7618;
		kbase_free_pages_worker.cfi_jt = . + 0xa7620;
		kbasep_kinstr_prfcnt_dump_worker.cfi_jt = . + 0xa7628;
		dump_worker.cfi_jt = . + 0xa7630;
		kbasep_protected_mode_hwcnt_disable_worker.cfi_jt = . + 0xa7638;
		kbase_pm_gpu_poweroff_wait_wq.cfi_jt = . + 0xa7640;
		kbase_pm_hwcnt_disable_worker.cfi_jt = . + 0xa7648;
		shader_poweroff_timer_stop_callback.cfi_jt = . + 0xa7650;
		core_idle_worker.cfi_jt = . + 0xa7658;
		kbase_devfreq_suspend_resume_worker.cfi_jt = . + 0xa7660;
		kbase_mmu_page_fault_worker.cfi_jt = . + 0xa7668;
		kbase_mmu_bus_fault_worker.cfi_jt = . + 0xa7670;
		kbase_mmu_gpu_fault_worker.cfi_jt = . + 0xa7678;
		kbasep_hwcnt_watchdog_callback.cfi_jt = . + 0xa7680;
		kbasep_hwcnt_backend_csf_dump_reenable_worker.cfi_jt = . + 0xa7688;
		kbasep_hwcnt_backend_csf_ring_buf_free_worker.cfi_jt = . + 0xa7690;
		kbasep_hwcnt_backend_csf_dump_worker.cfi_jt = . + 0xa7698;
		kbasep_hwcnt_backend_csf_threshold_worker.cfi_jt = . + 0xa76a0;
		oom_event_worker.cfi_jt = . + 0xa76a8;
		cs_error_worker.cfi_jt = . + 0xa76b0;
		timer_event_worker.cfi_jt = . + 0xa76b8;
		kbase_csf_glb_fatal_worker.cfi_jt = . + 0xa76c0;
		kbase_csf_scheduler_protm_pages_defer_worker.cfi_jt = . + 0xa76c8;
		firmware_aliveness_monitor.cfi_jt = . + 0xa76d0;
		pmode_exit_wa_worker.cfi_jt = . + 0xa76d8;
		kcpu_queue_process_worker.cfi_jt = . + 0xa76e0;
		kcpu_queue_timeout_worker.cfi_jt = . + 0xa76e8;
		kbase_csf_reset_gpu_worker.cfi_jt = . + 0xa76f0;
		kbase_csf_firmware_log_poll.cfi_jt = . + 0xa76f8;
		kbase_csf_firmware_reload_worker.cfi_jt = . + 0xa7700;
		kbase_ipa_ctrl_rate_change_worker.cfi_jt = . + 0xa7708;
		kbasep_hwcnt_backend_csf_if_fw_on_freq_change.cfi_jt = . + 0xa7710;
		kbase_ipa_control_rate_change_notify.cfi_jt = . + 0xa7718;
		kbase_ipa_control_rate_change_notify_ex.cfi_jt = . + 0xa7720;
		kbase_csf_scheduler_kthread.cfi_jt = . + 0xa7728;
		kbase_csf_scheduler_kcpuq_kthread.cfi_jt = . + 0xa7730;
		poll_temperature.cfi_jt = . + 0xa7738;
		kbase_device_runtime_disable.cfi_jt = . + 0xa7740;
		pm_callback_runtime_off.cfi_jt = . + 0xa7748;
		pm_callback_runtime_gpu_idle.cfi_jt = . + 0xa7750;
		pm_callback_runtime_gpu_active.cfi_jt = . + 0xa7758;
		pm_callback_power_off.cfi_jt = . + 0xa7760;
		pm_callback_suspend.cfi_jt = . + 0xa7768;
		pm_callback_resume.cfi_jt = . + 0xa7770;
		kbase_mem_term.cfi_jt = . + 0xa7778;
		kbase_ctx_sched_term.cfi_jt = . + 0xa7780;
		kbase_gpuprops_free_user_buffer.cfi_jt = . + 0xa7788;
		kbase_pm_context_idle.cfi_jt = . + 0xa7790;
		kbase_pm_context_active.cfi_jt = . + 0xa7798;
		kbase_release_device.cfi_jt = . + 0xa77a0;
		kbase_protected_mode_term.cfi_jt = . + 0xa77a8;
		registers_unmap.cfi_jt = . + 0xa77b0;
		power_control_term.cfi_jt = . + 0xa77b8;
		kbase_device_debugfs_term.cfi_jt = . + 0xa77c0;
		kbase_sysfs_term.cfi_jt = . + 0xa77c8;
		kbase_io_term.cfi_jt = . + 0xa77d0;
		kbase_device_pcm_dev_term.cfi_jt = . + 0xa77d8;
		kbase_device_misc_term.cfi_jt = . + 0xa77e0;
		kbase_device_hwcnt_context_term.cfi_jt = . + 0xa77e8;
		kbase_device_timeline_term.cfi_jt = . + 0xa77f0;
		kbase_device_io_history_term.cfi_jt = . + 0xa77f8;
		kbase_device_misc_deregister.cfi_jt = . + 0xa7800;
		kbase_device_list_term.cfi_jt = . + 0xa7808;
		kbase_device_early_term.cfi_jt = . + 0xa7810;
		kbase_device_late_term.cfi_jt = . + 0xa7818;
		kbase_device_hwcnt_watchdog_if_term.cfi_jt = . + 0xa7820;
		kbase_device_hwcnt_backend_csf_if_term.cfi_jt = . + 0xa7828;
		kbase_device_hwcnt_backend_csf_term.cfi_jt = . + 0xa7830;
		kbase_csf_early_term.cfi_jt = . + 0xa7838;
		kbase_backend_late_term.cfi_jt = . + 0xa7840;
		kbase_device_firmware_hwcnt_term.cfi_jt = . + 0xa7848;
		kbase_synchronize_irqs.cfi_jt = . + 0xa7850;
		kbase_pm_wait_for_gpu_power_down.cfi_jt = . + 0xa7858;
		kbase_hwaccess_pm_halt.cfi_jt = . + 0xa7860;
		kbase_pm_update_state.cfi_jt = . + 0xa7868;
		kbase_pm_reset_done.cfi_jt = . + 0xa7870;
		kbase_pm_request_gpu_cycle_counter_l2_is_on.cfi_jt = . + 0xa7878;
		kbase_pm_request_gpu_cycle_counter.cfi_jt = . + 0xa7880;
		kbase_pm_release_gpu_cycle_counter.cfi_jt = . + 0xa7888;
		kbase_pm_enable_interrupts.cfi_jt = . + 0xa7890;
		kbase_pm_disable_interrupts.cfi_jt = . + 0xa7898;
		kbasep_pm_metrics_term.cfi_jt = . + 0xa78a0;
		always_on_init.cfi_jt = . + 0xa78a8;
		always_on_term.cfi_jt = . + 0xa78b0;
		coarse_demand_init.cfi_jt = . + 0xa78b8;
		coarse_demand_term.cfi_jt = . + 0xa78c0;
		kbase_backend_invalidate_gpu_timestamp_offset.cfi_jt = . + 0xa78c8;
		kbase_clk_rate_trace_manager_term.cfi_jt = . + 0xa78d0;
		kbase_regmap_v14_8_init.cfi_jt = . + 0xa78d8;
		kbase_regmap_v12_init.cfi_jt = . + 0xa78e0;
		kbase_regmap_v11_init.cfi_jt = . + 0xa78e8;
		kbase_regmap_v10_8_init.cfi_jt = . + 0xa78f0;
		kbase_regmap_v10_10_init.cfi_jt = . + 0xa78f8;
		kbase_csf_scheduler_pm_resume.cfi_jt = . + 0xa7900;
		kbase_csf_scheduler_pm_idle.cfi_jt = . + 0xa7908;
		kbase_csf_scheduler_pm_active.cfi_jt = . + 0xa7910;
		kbase_csf_scheduler_force_wakeup.cfi_jt = . + 0xa7918;
		kbase_reset_gpu_allow.cfi_jt = . + 0xa7920;
		kbase_reset_gpu.cfi_jt = . + 0xa7928;
		kbase_csf_fence_timer_debugfs_term.cfi_jt = . + 0xa7930;
		kbase_csf_protected_memory_term.cfi_jt = . + 0xa7938;
		kbase_csf_firmware_trigger_mcu_sleep.cfi_jt = . + 0xa7940;
		kbase_csf_firmware_trigger_gpu_suspend.cfi_jt = . + 0xa7948;
		kbase_csf_firmware_reload_completed.cfi_jt = . + 0xa7950;
		kbase_debug_csf_fault_wait_completion.cfi_jt = . + 0xa7958;
		kbase_debug_csf_fault_term.cfi_jt = . + 0xa7960;
		kbase_ipa_control_term.cfi_jt = . + 0xa7968;
		kbase_ipa_control_init.cfi_jt = . + 0xa7970;
		kbase_ipa_control_handle_gpu_sleep_exit.cfi_jt = . + 0xa7978;
		kbase_ipa_control_handle_gpu_sleep_enter.cfi_jt = . + 0xa7980;
		kbase_ipa_control_handle_gpu_reset_pre.cfi_jt = . + 0xa7988;
		kbase_ipa_control_handle_gpu_reset_post.cfi_jt = . + 0xa7990;
		kbase_ipa_term.cfi_jt = . + 0xa7998;
		kbase_get_real_power.cfi_jt = . + 0xa79a0;
		kbase_get_real_power_locked.cfi_jt = . + 0xa79a8;
		kbase_ipa_model_ops_find.cfi_jt = . + 0xa79b0;
		kbase_ipa_model_name_from_id.cfi_jt = . + 0xa79b8;
		kbase_ipa_init_model.cfi_jt = . + 0xa79c0;
		kbase_device_runtime_init.cfi_jt = . + 0xa79c8;
		pm_callback_runtime_on.cfi_jt = . + 0xa79d0;
		pm_callback_power_on.cfi_jt = . + 0xa79d8;
		kbase_mem_init.cfi_jt = . + 0xa79e0;
		kbase_ctx_sched_init.cfi_jt = . + 0xa79e8;
		kbase_gpuprops_populate_user_buffer.cfi_jt = . + 0xa79f0;
		kbase_get_irqs.cfi_jt = . + 0xa79f8;
		kbase_protected_mode_init.cfi_jt = . + 0xa7a00;
		registers_map.cfi_jt = . + 0xa7a08;
		power_control_init.cfi_jt = . + 0xa7a10;
		kbase_device_debugfs_init.cfi_jt = . + 0xa7a18;
		kbase_device_coherency_init.cfi_jt = . + 0xa7a20;
		kbase_sysfs_init.cfi_jt = . + 0xa7a28;
		kbase_io_init.cfi_jt = . + 0xa7a30;
		kbase_device_pcm_dev_init.cfi_jt = . + 0xa7a38;
		kbase_device_misc_init.cfi_jt = . + 0xa7a40;
		kbase_device_hwcnt_context_init.cfi_jt = . + 0xa7a48;
		kbase_device_timeline_init.cfi_jt = . + 0xa7a50;
		kbase_device_io_history_init.cfi_jt = . + 0xa7a58;
		kbase_device_misc_register.cfi_jt = . + 0xa7a60;
		kbase_device_list_init.cfi_jt = . + 0xa7a68;
		kbase_device_early_init.cfi_jt = . + 0xa7a70;
		kbase_device_late_init.cfi_jt = . + 0xa7a78;
		kbase_device_firmware_init_once.cfi_jt = . + 0xa7a80;
		kbase_device_hwcnt_watchdog_if_init.cfi_jt = . + 0xa7a88;
		kbase_device_hwcnt_backend_csf_if_init.cfi_jt = . + 0xa7a90;
		kbase_device_hwcnt_backend_csf_init.cfi_jt = . + 0xa7a98;
		kbase_csf_early_init.cfi_jt = . + 0xa7aa0;
		kbase_backend_late_init.cfi_jt = . + 0xa7aa8;
		kbase_csf_late_init.cfi_jt = . + 0xa7ab0;
		kbase_pm_wait_for_poweroff_work_complete.cfi_jt = . + 0xa7ab8;
		kbase_pm_wait_for_desired_state.cfi_jt = . + 0xa7ac0;
		kbasep_pm_metrics_init.cfi_jt = . + 0xa7ac8;
		kbase_backend_time_init.cfi_jt = . + 0xa7ad0;
		kbase_clk_rate_trace_manager_init.cfi_jt = . + 0xa7ad8;
		kbase_csf_scheduler_wait_mcu_active.cfi_jt = . + 0xa7ae0;
		kbase_csf_scheduler_pm_suspend.cfi_jt = . + 0xa7ae8;
		kbase_reset_gpu_wait.cfi_jt = . + 0xa7af0;
		kbase_reset_gpu_silent.cfi_jt = . + 0xa7af8;
		kbase_reset_gpu_prevent_and_wait.cfi_jt = . + 0xa7b00;
		kbase_csf_fence_timer_debugfs_init.cfi_jt = . + 0xa7b08;
		kbase_csf_protected_memory_init.cfi_jt = . + 0xa7b10;
		kbase_csf_firmware_wait_for_gpu_suspend.cfi_jt = . + 0xa7b18;
		kbase_debug_csf_fault_init.cfi_jt = . + 0xa7b20;
		kbase_ipa_init.cfi_jt = . + 0xa7b28;
		kbase_simple_power_model_init.cfi_jt = . + 0xa7b30;
		kbase_simple_power_model_recalculate.cfi_jt = . + 0xa7b38;
		kbase_tvax_power_model_init.cfi_jt = . + 0xa7b40;
		kbase_ttux_power_model_init.cfi_jt = . + 0xa7b48;
		kbase_ttix_power_model_init.cfi_jt = . + 0xa7b50;
		kbase_todx_power_model_init.cfi_jt = . + 0xa7b58;
		kbase_tkrx_power_model_init.cfi_jt = . + 0xa7b60;
		kbase_tgrx_power_model_init.cfi_jt = . + 0xa7b68;
		kbase_tdrx_power_model_init.cfi_jt = . + 0xa7b70;
		model_dynamic_coeff.cfi_jt = . + 0xa7b78;
		model_static_coeff.cfi_jt = . + 0xa7b80;
		kbase_ipa_counter_dynamic_coeff.cfi_jt = . + 0xa7b88;
		kbase_simple_power_model_term.cfi_jt = . + 0xa7b90;
		kbase_ipa_term_model.cfi_jt = . + 0xa7b98;
		kbase_ipa_counter_reset_data.cfi_jt = . + 0xa7ba0;
		kbase_ipa_counter_common_model_term.cfi_jt = . + 0xa7ba8;
		kbase_ipa_model_param_set_s32.cfi_jt = . + 0xa7bb0;
		mtk_dvfs_gpu_utilization_open.cfi_jt = . + 0xa7bb8;
		single_release.cfi_jt = . + 0xa7bc0;
		kbase_jit_debugfs_phys_fops_open.cfi_jt = . + 0xa7bc8;
		kbase_jit_debugfs_common_release.cfi_jt = . + 0xa7bd0;
		kbase_jit_debugfs_vm_fops_open.cfi_jt = . + 0xa7bd8;
		kbase_jit_debugfs_count_fops_open.cfi_jt = . + 0xa7be0;
		kbasep_kinstr_prfcnt_hwcnt_reader_release.cfi_jt = . + 0xa7be8;
		kbasep_gpu_memory_debugfs_open.cfi_jt = . + 0xa7bf0;
		kbase_device_debugfs_heap_reclaim_offslot_open.cfi_jt = . + 0xa7bf8;
		fops_trigger_reset_open.cfi_jt = . + 0xa7c00;
		simple_attr_release.cfi_jt = . + 0xa7c08;
		simple_open.cfi_jt = . + 0xa7c10;
		fops_ne_quirks_open.cfi_jt = . + 0xa7c18;
		fops_gpu_quirks_open.cfi_jt = . + 0xa7c20;
		fops_mmu_quirks_open.cfi_jt = . + 0xa7c28;
		fops_tiler_quirks_open.cfi_jt = . + 0xa7c30;
		fops_sc_quirks_open.cfi_jt = . + 0xa7c38;
		kbase_open.cfi_jt = . + 0xa7c40;
		kbase_release.cfi_jt = . + 0xa7c48;
		kbasep_mem_profile_debugfs_open.cfi_jt = . + 0xa7c50;
		debug_mem_open.cfi_jt = . + 0xa7c58;
		debug_mem_release.cfi_jt = . + 0xa7c60;
		debug_mem_zones_open.cfi_jt = . + 0xa7c68;
		debug_mem_allocs_open.cfi_jt = . + 0xa7c70;
		kbase_mem_pool_debugfs_max_size_open.cfi_jt = . + 0xa7c78;
		kbase_mem_pool_debugfs_open.cfi_jt = . + 0xa7c80;
		kbase_dev_mem_pool_debugfs_max_size_open.cfi_jt = . + 0xa7c88;
		kbase_dev_mem_pool_debugfs_open.cfi_jt = . + 0xa7c90;
		kbasep_dvfs_utilization_debugfs_open.cfi_jt = . + 0xa7c98;
		regs_history_open.cfi_jt = . + 0xa7ca0;
		regs_history_size_fops_open.cfi_jt = . + 0xa7ca8;
		propagate_bits_open.cfi_jt = . + 0xa7cb0;
		int_id_overrides_open.cfi_jt = . + 0xa7cb8;
		timestamp_offset_debugfs_fops_open.cfi_jt = . + 0xa7cc0;
		kbasep_timeline_io_release.cfi_jt = . + 0xa7cc8;
		kbasep_timeline_io_open.cfi_jt = . + 0xa7cd0;
		kbase_csf_tl_poll_interval_fops_open.cfi_jt = . + 0xa7cd8;
		kbasep_csf_queue_group_debugfs_open.cfi_jt = . + 0xa7ce0;
		kbasep_csf_debugfs_eviction_timeout_fops_open.cfi_jt = . + 0xa7ce8;
		kbasep_csf_debugfs_scheduling_timer_kick_fops_open.cfi_jt = . + 0xa7cf0;
		kbasep_csf_debugfs_scheduling_timer_enabled_fops_open.cfi_jt = . + 0xa7cf8;
		kbasep_csf_active_queue_groups_debugfs_open.cfi_jt = . + 0xa7d00;
		kbasep_csf_kcpu_debugfs_open.cfi_jt = . + 0xa7d08;
		kbasep_csf_sync_debugfs_open.cfi_jt = . + 0xa7d10;
		kbasep_csf_tiler_heap_debugfs_open.cfi_jt = . + 0xa7d18;
		kbasep_csf_tiler_heap_total_debugfs_open.cfi_jt = . + 0xa7d20;
		kbasep_csf_cpu_queue_debugfs_open.cfi_jt = . + 0xa7d28;
		kbase_csf_firmware_log_poll_period_fops_open.cfi_jt = . + 0xa7d30;
		kbase_csf_firmware_log_mode_fops_open.cfi_jt = . + 0xa7d38;
		kbasep_csf_firmware_log_debugfs_open.cfi_jt = . + 0xa7d40;
		kbase_csf_firmware_log_enable_mask_fops_open.cfi_jt = . + 0xa7d48;
		fw_core_dump_debugfs_open.cfi_jt = . + 0xa7d50;
		fw_core_dump_debugfs_release.cfi_jt = . + 0xa7d58;
		debug_csf_fault_open.cfi_jt = . + 0xa7d60;
		debug_csf_fault_release.cfi_jt = . + 0xa7d68;
		force_fallback_model_open.cfi_jt = . + 0xa7d70;
		current_power_open.cfi_jt = . + 0xa7d78;
		fops_s32_open.cfi_jt = . + 0xa7d80;
		ne_quirks_get.cfi_jt = . + 0xa7d88;
		gpu_quirks_get.cfi_jt = . + 0xa7d90;
		mmu_quirks_get.cfi_jt = . + 0xa7d98;
		tiler_quirks_get.cfi_jt = . + 0xa7da0;
		sc_quirks_get.cfi_jt = . + 0xa7da8;
		regs_history_size_get.cfi_jt = . + 0xa7db0;
		kbase_gpu_timestamp_offset_read.cfi_jt = . + 0xa7db8;
		kbase_csf_tl_debugfs_poll_interval_read.cfi_jt = . + 0xa7dc0;
		kbasep_csf_debugfs_eviction_timeout_get.cfi_jt = . + 0xa7dc8;
		kbasep_csf_debugfs_scheduling_timer_enabled_get.cfi_jt = . + 0xa7dd0;
		kbase_csf_firmware_log_poll_period_read.cfi_jt = . + 0xa7dd8;
		kbase_csf_firmware_log_mode_read.cfi_jt = . + 0xa7de0;
		kbase_csf_firmware_log_enable_mask_read.cfi_jt = . + 0xa7de8;
		force_fallback_model_get.cfi_jt = . + 0xa7df0;
		current_power_get.cfi_jt = . + 0xa7df8;
		param_int_get.cfi_jt = . + 0xa7e00;
		__traceiter_hwcnt_skip_rearming.cfi_jt = . + 0xa7e08;
		kbase_device_debugfs_reset_write.cfi_jt = . + 0xa7e10;
		ne_quirks_set.cfi_jt = . + 0xa7e18;
		gpu_quirks_set.cfi_jt = . + 0xa7e20;
		mmu_quirks_set.cfi_jt = . + 0xa7e28;
		tiler_quirks_set.cfi_jt = . + 0xa7e30;
		sc_quirks_set.cfi_jt = . + 0xa7e38;
		regs_history_size_set.cfi_jt = . + 0xa7e40;
		kbase_csf_tl_debugfs_poll_interval_write.cfi_jt = . + 0xa7e48;
		kbasep_csf_debugfs_eviction_timeout_set.cfi_jt = . + 0xa7e50;
		kbasep_csf_debugfs_scheduling_timer_kick_set.cfi_jt = . + 0xa7e58;
		kbasep_csf_debugfs_scheduling_timer_enabled_set.cfi_jt = . + 0xa7e60;
		kbase_csf_firmware_log_poll_period_write.cfi_jt = . + 0xa7e68;
		kbase_csf_firmware_log_mode_write.cfi_jt = . + 0xa7e70;
		kbase_csf_firmware_log_enable_mask_write.cfi_jt = . + 0xa7e78;
		force_fallback_model_set.cfi_jt = . + 0xa7e80;
		param_int_set.cfi_jt = . + 0xa7e88;
		seq_read.cfi_jt = . + 0xa7e90;
		kbase_jit_debugfs_common_read.cfi_jt = . + 0xa7e98;
		debugfs_attr_read.cfi_jt = . + 0xa7ea0;
		debugfs_protected_debug_mode_read.cfi_jt = . + 0xa7ea8;
		kbase_read.cfi_jt = . + 0xa7eb0;
		read_ctx_force_same_va.cfi_jt = . + 0xa7eb8;
		read_ctx_infinite_cache.cfi_jt = . + 0xa7ec0;
		kbasep_timeline_io_read.cfi_jt = . + 0xa7ec8;
		kbase_csf_debugfs_scheduler_state_get.cfi_jt = . + 0xa7ed0;
		kbase_csf_kcpu_queue_fence_signal_timeout_get.cfi_jt = . + 0xa7ed8;
		kbase_csf_kcpu_queue_fence_signal_enabled_get.cfi_jt = . + 0xa7ee0;
		kbasep_csf_firmware_log_debugfs_read.cfi_jt = . + 0xa7ee8;
		kbase_csf_ne_control_mac_step_cycles_get.cfi_jt = . + 0xa7ef0;
		kbase_csf_ne_control_hi_latency_limit_get.cfi_jt = . + 0xa7ef8;
		kbase_csf_ne_control_lo_latency_limit_get.cfi_jt = . + 0xa7f00;
		debug_csf_fault_read.cfi_jt = . + 0xa7f08;
		param_string_get.cfi_jt = . + 0xa7f10;
		kbase_device_debugfs_heap_reclaim_offslot_write.cfi_jt = . + 0xa7f18;
		debugfs_attr_write.cfi_jt = . + 0xa7f20;
		write_ctx_force_same_va.cfi_jt = . + 0xa7f28;
		write_ctx_infinite_cache.cfi_jt = . + 0xa7f30;
		debug_mem_write.cfi_jt = . + 0xa7f38;
		kbase_mem_pool_debugfs_max_size_write.cfi_jt = . + 0xa7f40;
		kbase_mem_pool_debugfs_write.cfi_jt = . + 0xa7f48;
		kbase_dev_mem_pool_debugfs_max_size_write.cfi_jt = . + 0xa7f50;
		kbase_dev_mem_pool_debugfs_write.cfi_jt = . + 0xa7f58;
		propagate_bits_write.cfi_jt = . + 0xa7f60;
		int_id_overrides_write.cfi_jt = . + 0xa7f68;
		kbase_csf_debugfs_scheduler_state_set.cfi_jt = . + 0xa7f70;
		kbase_csf_kcpu_queue_fence_signal_timeout_set.cfi_jt = . + 0xa7f78;
		kbase_csf_kcpu_queue_fence_signal_enabled_set.cfi_jt = . + 0xa7f80;
		fw_core_dump_debugfs_write.cfi_jt = . + 0xa7f88;
		kbase_csf_ne_control_mac_step_cycles_set.cfi_jt = . + 0xa7f90;
		kbase_csf_ne_control_hi_latency_limit_set.cfi_jt = . + 0xa7f98;
		kbase_csf_ne_control_lo_latency_limit_set.cfi_jt = . + 0xa7fa0;
		debug_csf_fault_write.cfi_jt = . + 0xa7fa8;
		param_string_set.cfi_jt = . + 0xa7fb0;
	}
}
